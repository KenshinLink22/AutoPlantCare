/**
 * @cliArgs --device "CC3200" --package "Default" --part "Default"
 * @versions {"tool":"1.15.0+2826"}
 */

/**
 * These are the peripherals and settings in this configuration
 */
const iADC1               = scripting.addPeripheral("ADC");
iADC1.$name               = "Photoresistor_ADC";
iADC1.$assign             = "ADC0";
iADC1.CH0.$used           = false;
iADC1.CH1.$assign         = "ball.58";
iADC1.CH2.$assign         = "ball.59";
iADC1.CH3.$used           = false;
const iGPIO1              = scripting.addPeripheral("GPIO");
iGPIO1.$name              = "GPIO_Pins";
iGPIO1.GPIO00.io          = "output";
iGPIO1.GPIO00.$assign     = "ball.50";
iGPIO1.GPIO01.io          = "output";
iGPIO1.GPIO01.$assign     = "ball.55";
iGPIO1.GPIO01.$used       = false;
iGPIO1.GPIO02.io          = "output";
iGPIO1.GPIO02.$assign     = "ball.57";
iGPIO1.GPIO02.$used       = false;
iGPIO1.GPIO03.$used       = false;
iGPIO1.GPIO04.$used       = false;
iGPIO1.GPIO05.io          = "output";
iGPIO1.GPIO05.$assign     = "ball.60";
iGPIO1.GPIO06.io          = "output";
iGPIO1.GPIO06.$assign     = "ball.61";
iGPIO1.GPIO07.io          = "output";
iGPIO1.GPIO07.$assign     = "ball.62";
iGPIO1.GPIO08.io          = "output";
iGPIO1.GPIO08.$assign     = "ball.63";
iGPIO1.GPIO09.$used       = false;
iGPIO1.GPIO10.$used       = false;
iGPIO1.GPIO11.$used       = false;
iGPIO1.GPIO12.$assign     = "ball.3";
iGPIO1.GPIO13.$assign     = "ball.4";
iGPIO1.GPIO14.$used       = false;
iGPIO1.GPIO15.$assign     = "ball.6";
iGPIO1.GPIO15.$used       = false;
iGPIO1.GPIO16.$used       = false;
iGPIO1.GPIO17.$used       = false;
iGPIO1.GPIO22.$used       = false;
iGPIO1.GPIO23.$used       = false;
iGPIO1.GPIO24.$used       = false;
iGPIO1.GPIO28.$used       = false;
iGPIO1.GPIO29.$used       = false;
iGPIO1.GPIO25.$used       = false;
iGPIO1.GPIO30.$assign     = "ball.53";
iGPIO1.GPIO30.$used       = false;
iGPIO1.GPIO31.$used       = false;
iGPIO1.GPIO32.io          = "output";
iGPIO1.GPIO32.$used       = false;
const iI2C1               = scripting.addPeripheral("I2C");
iI2C1.$name               = "MoistureSensor_I2C";
iI2C1.$assign             = "I2C0";
iI2C1.SCL.$assign         = "ball.1";
iI2C1.SDA.$assign         = "ball.2";
const iSPI1               = scripting.addPeripheral("SPI");
iSPI1.$name               = "OLED_SPI";
iSPI1.CS.$assign          = "ball.8";
iSPI1.CLK.$assign         = "ball.5";
iSPI1.MISO.$used          = false;
iSPI1.MOSI.$assign        = "ball.7";
const iTimerPWM1          = scripting.addPeripheral("TimerPWM");
iTimerPWM1.$name          = "MyTimerPWM1";
iTimerPWM1.$assign        = "TimerPWM0";
iTimerPWM1.GT_PWM.$assign = "ball.17";
iTimerPWM1.GT_PWM.$used   = false;

/**
 * Pinmux solution for unlocked pins/peripherals. This ensures that minor changes to the automatic solver in a future
 * version of the tool will not impact the pinmux you originally saw.  These lines can be completely deleted in order to
 * re-solve from scratch.
 */
iGPIO1.$suggestSolution = "GPIO";
iSPI1.$suggestSolution  = "SPI0";
